## libs/libssh2/Config.in
```kconfig
if PACKAGE_libssh2

choice
	prompt "Choose crypto backend"
	default LIBSSH2_OPENSSL

	config LIBSSH2_MBEDTLS
	bool "mbedtls"

	config LIBSSH2_OPENSSL
	bool "openssl"

endchoice

endif
```
